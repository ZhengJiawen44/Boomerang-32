/*  
 Test the tft.print() viz. embedded tft.write() function

 This sketch used font 2, 4, 7
 
 Make sure all the display driver and pin connections are correct by
 editing the User_Setup.h file in the TFT_eSPI library folder.

 Note that yield() or delay(0) must be called in long duration for/while
 loops to stop the ESP8266 watchdog triggering.

 #########################################################################
 ###### DON'T FORGET TO UPDATE THE User_Setup.h FILE IN THE LIBRARY ######
 #########################################################################
 */

#include <Preferences.h>
Preferences pref;
#include <TFT_eSPI.h> // Graphics and font library for ST7735 driver chip
#include <SPI.h>

TFT_eSPI tft = TFT_eSPI();  // Invoke library, pins defined in User_Setup.h

#define TFT_GREY 0x5AEB // New colour
#define SENSOR_PIN  33
int brightness=255;
bool isMinBright = false;
const unsigned char epd_bitmap_____ [] PROGMEM = {
	0x00, 0x00, 0x00, 0x00, 0x00, 0x00, 0x00, 0x00, 0x00, 0x00, 0x00, 0x00, 0x00, 0x00, 0x00, 0x00, 
	0x00, 0x00, 0x00, 0x00, 0x00, 0x00, 0x00, 0x00, 0x00, 0x00, 0x00, 0x00, 0x00, 0x00, 0x00, 0x00, 
	0x00, 0x00, 0x00, 0x00, 0x00, 0x00, 0x00, 0x00, 0x00, 0x00, 0x00, 0x00, 0x00, 0x00, 0x00, 0x00, 
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	0x00, 0x00, 0x00, 0x00, 0x00, 0x00, 0x00, 0x00, 0x00, 0x00, 0x00, 0x00, 0x00, 0x00, 0x00, 0x00
};

void setup(void) {
  //Create a namespace called "settings" with read/write mode
  pref.begin("settings", false);
  // read the last Last brightness from nvs flash memory
  brightness = 	pref.getInt("brightness", 255);
  analogWrite(5, brightness);
  Serial.begin(115200);
  tft.init();
  pinMode(SENSOR_PIN, INPUT);
  tft.fillScreen(TFT_GREY);
  tft.setCursor(60,60, 2);
  // Set the font colour to be white with a black background, set text size multiplier to 1
  tft.setTextColor(TFT_WHITE);  tft.setTextSize(1);
  // We can now plot text on screen using the "print" class
  //tft.println("Owari da!");
  tft.drawBitmap(0,0,epd_bitmap_____,240,240, TFT_WHITE, TFT_BLACK);
}

void loop() {
  
  tft.setTextColor(TFT_WHITE,TFT_GREY);
  int state = digitalRead(SENSOR_PIN);
  tft.setCursor(60,80, 2);
  float percentage = (brightness/255.0)*100;
  tft.println(String(percentage,1));
  if(state == 1 && (brightness-5)>=0){
    brightness-=5;
    delay(50);
    analogWrite(5, brightness);
  }
  if(brightness==0){
    Serial.println("min brightness");
    isMinBright = true;
  }
  if(brightness==255){
    Serial.println("min brightness");
    isMinBright = false;
  }
  if(isMinBright){
    while(brightness<=255 && state==1 && brightness+5 <=255){
      brightness+=5;
      delay(50);
      analogWrite(5, brightness);
      state = digitalRead(SENSOR_PIN);
      percentage = (brightness/255.0)*100;
      tft.setCursor(60,80, 2);
      tft.println(String(percentage,1));
    }
    
  }
  Serial.println(brightness);
  pref.putInt("brightness", brightness);
}



